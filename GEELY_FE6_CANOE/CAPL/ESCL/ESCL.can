/*MMMMMMMMMMMMNNNNNMMMMMMMMMMMMMMMMMMMMMMMMMMMNNNNNMMMMMMMMMMMMMMMMMMMMMMMMMMMNNNNNNMMMMMMMMMMMMM*/
/*M+NMMMNdyso+////++oyhmNMMMMMMMMMMMMMMMNmhso++////+oshmNMMMMMMMMMMMMMMMNmhyo++////+osydNNNNMNNNM*/
/*M+NMMd///+osyyyyss+///+smNMMMMMMMMMNds+///osyyyyyso////sdNMMMMMMMMMNmy+///+osyyyyso+///ohNNNNNM*/
/*M+NNMdohmNNMNNNNNNNNdy+//odNMMMMNNh+//+ymNNNNNNNNNNNmy+//+hNNNNNNNdo//+sdNNNNNNNNNNNmho//+yNNNM*/
/*M+NNNNNNNmhysooosydNNNNh+//yNNNNms//+dNNNNdysooosydNNNNdo//omNNNNy//+hNNNNdysooooyhmNNNms//+dNM*/
/*M+NNNNNdo//////////+ymNNmo//smmdo//sNNNms///////////sdmmdo//+dmms//omNNNy+//////////odmmms//+dM*/
/*M+mNNNy//////////////+mNNm+///////oNNNd+//////////////////////////+mNNm+/////////////////////oM*/
/*M+mNNd////////////////sNNNmdddhhhhmNNm+////////////////hhhhhhhhhhhdNNNmhhhhhhhhhhhhhhhhhhhh///M*/
/*M+mNNd////////////////oNNNNNNNNNNNNNNm+////////////////dNNNNNNNNNNNNNNNNNNNNNNNNNNNNNNNNNNm+//M*/
/*M/hNNmo///////////////hNNNs///////yNNNy///////////////////////////////////////////////omNNh//+M*/
/*M/+dNNms////////////+hNNNy//+sss///hNNmy/////////////ssss+///sss+///ssss+////////////smNNd+//yM*/
/*M//+hmNNmyo+/////+shmNNms//+dNNNh+//ymNNmho+/////+ohmNNmy///hNNNd+//odNNmhs+//////oymNNmh+//ymM*/
/*Mh+//+ymNNNmmmdmmNNNmds///smNNNNNdo//+ydmNNNmmdmmmNNmdy+//odNNNNNms///sdmNNNmmdmmmNNNmy+//+hmNM*/
/*Mmmho///+syhdddddhyo+///sdmNNNNNNNmho///+syhdddddhys+///ohmNNNNNNNNds+//+oyhdddddhys+///ohmNNNM*/
/*Mmmmmdyo+///////////oshmmmNmmmmmmNNmmmhs+///////////+shmmNNNNNNNNNNNNmhso///////////+oydmNNmmmM*/
/*MmmmmmmmmmdhyyyyhddmmmmmmmmmmmmmmmmmmmmmmmddhyyyhddmmmmmmmmmmmmmmmmmmmmmmmddhyyyyhdmmmmmmmmmmmM*/
/*MMMMMMMMMMMMNNNNNMMMMMMMMMMMMMMMMMMMMMMMMMMMNNNNNMMMMMMMMMMMMMMMMMMMMMMMMMMMNNNNNNMMMMMMMMMMMMM*

  filename:     ESCL.can
  
  description:  Brief: ESCL
                Generation date: 12/05/2020 14:30:13
                DBC File: TRW_FE-6 ECU DBC V1.9_Release_ESCL_20171114.dbc
                User Name: BenY
                
  ATTENTIONS:   This file code generated by Tool automatically, don't modify this 
                file manually.  
 ----------------------------------------------------------------------------- */
/* -----------------------------------------------------------------------------
  C O P Y R I G H T
 -------------------------------------------------------------------------------
  Copyright (c) 2019 by Yueting Ben. All rights reserved.
 -------------------------------------------------------------------------------
/**************************************************************************************************/
 variables
{
  message NWM_ESCL NWM_ESCL_Frame;
  message ESCL_Message_Info ESCL_Message_Info_Frame;
  msTimer NWM_ESCL_Timer;
  msTimer ESCL_Message_Info_Timer;
  byte NWM_ESCL_EnableFlag;
  byte ESCL_Message_Info_EnableFlag;
  byte ESCL_Message_Info_MsgCounterEnable;
  byte ESCL_Message_Info_CheckSumEnable;
}
on start
{
  setTimer(NWM_ESCL_Timer, 0);
  setTimer(ESCL_Message_Info_Timer, 0);
  NWM_ESCL_EnableFlag = @sysvar::MESSAGEFRAME::NWM_ESCLMessageEnable & @sysvar::NODE::ESCLEnableAll_Msg;
  ESCL_Message_Info_EnableFlag = @sysvar::MESSAGEFRAME::ESCL_Message_InfoMessageEnable & @sysvar::NODE::ESCLEnableAll_Msg;
  ESCL_Message_Info_MsgCounterEnable = @sysvar::MESSAGEFRAME::ESCL_Message_InfoMsgCounterEnable;
  ESCL_Message_Info_CheckSumEnable = @sysvar::MESSAGEFRAME::ESCL_Message_InfoCheckSumEnable;
}

/**************************************************************************************************/
/*
  brief:        Send NWM_ESCL in cycle
  
  author:       Generation tool
*/
/**************************************************************************************************/
 on Timer NWM_ESCL_Timer
{
  if(1 == NWM_ESCL_EnableFlag)
  {
    output(NWM_ESCL_Frame);
  }
  NWM_ESCL_Frame.ESCL_Address = @sysvar::SIGNALINFO::ESCL_AddressValue;
  NWM_ESCL_Frame.ESCL_AWB = @sysvar::SIGNALINFO::ESCL_AWBValue;
  NWM_ESCL_Frame.ESCL_Wakeup_reasons = @sysvar::SIGNALINFO::ESCL_Wakeup_reasonsValue;
  NWM_ESCL_Frame.ESCL_NMSts = @sysvar::SIGNALINFO::ESCL_NMStsValue;
  NWM_ESCL_Frame.ESCL_Stayawake_reasons_bit32 = @sysvar::SIGNALINFO::ESCL_Stayawake_reasons_bit32Value;
  NWM_ESCL_Frame.ESCL_Stayawake_reasons_bit33 = @sysvar::SIGNALINFO::ESCL_Stayawake_reasons_bit33Value;
  NWM_ESCL_Frame.ESCL_Stayawake_reasons_bit34 = @sysvar::SIGNALINFO::ESCL_Stayawake_reasons_bit34Value;
  NWM_ESCL_Frame.ESCL_Stayawake_reasons_bit36 = @sysvar::SIGNALINFO::ESCL_Stayawake_reasons_bit36Value;
  NWM_ESCL_Frame.ESCL_Stayawake_reasons_bit37 = @sysvar::SIGNALINFO::ESCL_Stayawake_reasons_bit37Value;
  NWM_ESCL_Frame.ESCL_Stayawake_reasons_bit38 = @sysvar::SIGNALINFO::ESCL_Stayawake_reasons_bit38Value;
  NWM_ESCL_Frame.ESCL_Stayawake_reasons_bit39 = @sysvar::SIGNALINFO::ESCL_Stayawake_reasons_bit39Value;
  NWM_ESCL_Frame.ESCL_Stayawake_reasons_bit40 = @sysvar::SIGNALINFO::ESCL_Stayawake_reasons_bit40Value;
  NWM_ESCL_Frame.ESCL_Stayawake_reasons_bit41 = @sysvar::SIGNALINFO::ESCL_Stayawake_reasons_bit41Value;
  NWM_ESCL_Frame.ESCL_Stayawake_reasons_bit42 = @sysvar::SIGNALINFO::ESCL_Stayawake_reasons_bit42Value;
  NWM_ESCL_Frame.ESCL_RMR = @sysvar::SIGNALINFO::ESCL_RMRValue;
  setTimer(NWM_ESCL_Timer, 500);
}

/**************************************************************************************************/
/*
  brief:        Send ESCL_Message_Info in cycle
  
  author:       Generation tool
*/
/**************************************************************************************************/
 on Timer ESCL_Message_Info_Timer
{
  byte ESCL_Message_Info_MsgCounter;
  byte ESCL_Message_Info_CheckSum;
  if(1 == ESCL_Message_Info_EnableFlag)
  {
    output(ESCL_Message_Info_Frame);
  }
  ESCL_Message_Info_Frame.ESCL_SteeringLockStatus = @sysvar::SIGNALINFO::ESCL_SteeringLockStatusValue;
  ESCL_Message_Info_Frame.ESCL_release = @sysvar::SIGNALINFO::ESCL_releaseValue;
  ESCL_Message_Info_Frame.ESCL_SystemWarning = @sysvar::SIGNALINFO::ESCL_SystemWarningValue;
  ESCL_Message_Info_Frame.ESCL_Learning_Status = @sysvar::SIGNALINFO::ESCL_Learning_StatusValue;
  if(1 == ESCL_Message_Info_MsgCounterEnable)
  {
    @sysvar::SIGNALINFO::ESCL_Message_Info_AliveCounterValue = ESCL_Message_Info_MsgCounter;
    ESCL_Message_Info_Frame.ESCL_Message_Info_AliveCounter = @sysvar::SIGNALINFO::ESCL_Message_Info_AliveCounterValue;
    ESCL_Message_Info_MsgCounter = ESCL_Message_Info_MsgCounter + 1;
  }
  /* Calculate checksum */ 
  ESCL_Message_Info_CheckSum = ESCL_Message_Info_Frame.byte(0)
                          ^ ESCL_Message_Info_Frame.byte(1)
                          ^ ESCL_Message_Info_Frame.byte(2)
                          ^ ESCL_Message_Info_Frame.byte(3)
                          ^ ESCL_Message_Info_Frame.byte(4)
                          ^ ESCL_Message_Info_Frame.byte(5)
                          ^ ESCL_Message_Info_Frame.byte(6);
  if(1 == ESCL_Message_Info_CheckSumEnable)
  {
    @sysvar::SIGNALINFO::ESCL_Message_Info_CheckSumValue = ESCL_Message_Info_CheckSum;
    ESCL_Message_Info_Frame.ESCL_Message_Info_CheckSum = @sysvar::SIGNALINFO::ESCL_Message_Info_CheckSumValue;
  }
  ESCL_Message_Info_Frame.ESCL_Unlock_Failure_Warning = @sysvar::SIGNALINFO::ESCL_Unlock_Failure_WarningValue;
  ESCL_Message_Info_Frame.ESCL_Lock_Failure_Warning = @sysvar::SIGNALINFO::ESCL_Lock_Failure_WarningValue;
  ESCL_Message_Info_Frame.ESCL_BatteryVoltage_Warning = @sysvar::SIGNALINFO::ESCL_BatteryVoltage_WarningValue;
  setTimer(ESCL_Message_Info_Timer, 100);
}

/**************************************************************************************************/
/*
  brief:        Check the CheckBox ESCL_EnableAll_Msg
  
  author:       Generation tool
*/
/**************************************************************************************************/
 on sysvar NODE::ESCLEnableAll_Msg
{
  if(1 == @sysvar::NODE::ESCLEnableAll_Msg)
  {
    @sysvar::NODE::ESCLEnableAll_Msg = 1;
    @sysvar::NODE::ESCLDisableAll_Msg = 0;
    @sysvar::MESSAGEFRAME::NWM_ESCLMessageEnable = 1;
    NWM_ESCL_EnableFlag = @sysvar::MESSAGEFRAME::NWM_ESCLMessageEnable & @sysvar::NODE::ESCLEnableAll_Msg;
    @sysvar::MESSAGEFRAME::ESCL_Message_InfoMessageEnable = 1;
    ESCL_Message_Info_EnableFlag = @sysvar::MESSAGEFRAME::ESCL_Message_InfoMessageEnable & @sysvar::NODE::ESCLEnableAll_Msg;
  }
  else
  {
    @sysvar::NODE::ESCLEnableAll_Msg = 0;
    @sysvar::NODE::ESCLDisableAll_Msg = 1;
    @sysvar::MESSAGEFRAME::NWM_ESCLMessageEnable = 0;
    NWM_ESCL_EnableFlag = @sysvar::MESSAGEFRAME::NWM_ESCLMessageEnable & @sysvar::NODE::ESCLEnableAll_Msg;
    @sysvar::MESSAGEFRAME::ESCL_Message_InfoMessageEnable = 0;
    ESCL_Message_Info_EnableFlag = @sysvar::MESSAGEFRAME::ESCL_Message_InfoMessageEnable & @sysvar::NODE::ESCLEnableAll_Msg;
  }
}

/**************************************************************************************************/
/*
  brief:        Check the CheckBox ESCL_DisableAll_Msg
  
  author:       Generation tool
*/
/**************************************************************************************************/
 on sysvar NODE::ESCLDisableAll_Msg
{
  if(1 == @sysvar::NODE::ESCLDisableAll_Msg)
  {
    @sysvar::NODE::ESCLEnableAll_Msg = 0;
    @sysvar::NODE::ESCLDisableAll_Msg = 1;
    @sysvar::MESSAGEFRAME::NWM_ESCLMessageEnable = 0;
    NWM_ESCL_EnableFlag = @sysvar::MESSAGEFRAME::NWM_ESCLMessageEnable & @sysvar::NODE::ESCLEnableAll_Msg;
    @sysvar::MESSAGEFRAME::ESCL_Message_InfoMessageEnable = 0;
    ESCL_Message_Info_EnableFlag = @sysvar::MESSAGEFRAME::ESCL_Message_InfoMessageEnable & @sysvar::NODE::ESCLEnableAll_Msg;
  }
  else
  {
    @sysvar::NODE::ESCLEnableAll_Msg = 1;
    @sysvar::NODE::ESCLDisableAll_Msg = 0;
    @sysvar::MESSAGEFRAME::NWM_ESCLMessageEnable = 1;
    NWM_ESCL_EnableFlag = @sysvar::MESSAGEFRAME::NWM_ESCLMessageEnable & @sysvar::NODE::ESCLEnableAll_Msg;
    @sysvar::MESSAGEFRAME::ESCL_Message_InfoMessageEnable = 1;
    ESCL_Message_Info_EnableFlag = @sysvar::MESSAGEFRAME::ESCL_Message_InfoMessageEnable & @sysvar::NODE::ESCLEnableAll_Msg;
  }
}

/**************************************************************************************************/
/*
  brief:        Check the CheckBox NWM_ESCL MessageEnable
  
  author:       Generation tool
*/
/**************************************************************************************************/
 on sysvar MESSAGEFRAME::NWM_ESCLMessageEnable
{
  NWM_ESCL_EnableFlag = @sysvar::MESSAGEFRAME::NWM_ESCLMessageEnable & @sysvar::NODE::ESCLEnableAll_Msg;
}

/**************************************************************************************************/
/*
  brief:        Check the CheckBox ESCL_Message_Info MessageEnable
  
  author:       Generation tool
*/
/**************************************************************************************************/
 on sysvar MESSAGEFRAME::ESCL_Message_InfoMessageEnable
{
  ESCL_Message_Info_EnableFlag = @sysvar::MESSAGEFRAME::ESCL_Message_InfoMessageEnable & @sysvar::NODE::ESCLEnableAll_Msg;
}

/**************************************************************************************************/
/*
  brief:        Check the CheckBox ESCL_Message_Info MsgCounterEnable
  
  author:       Generation tool
*/
/**************************************************************************************************/
 on sysvar MESSAGEFRAME::ESCL_Message_InfoMsgCounterEnable
{
  ESCL_Message_Info_MsgCounterEnable = @sysvar::MESSAGEFRAME::ESCL_Message_InfoMsgCounterEnable;
}

/**************************************************************************************************/
/*
  brief:        Check the CheckBox ESCL_Message_Info CheckSumEnable
  
  author:       Generation tool
*/
/**************************************************************************************************/
 on sysvar MESSAGEFRAME::ESCL_Message_InfoCheckSumEnable
{
  ESCL_Message_Info_CheckSumEnable = @sysvar::MESSAGEFRAME::ESCL_Message_InfoCheckSumEnable;
}

