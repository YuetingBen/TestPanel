/*@!Encoding:936*/
/*MMMMMMMMMMMMNNNNNMMMMMMMMMMMMMMMMMMMMMMMMMMMNNNNNMMMMMMMMMMMMMMMMMMMMMMMMMMMNNNNNNMMMMMMMMMMMMM*/
/*M+NMMMNdyso+////++oyhmNMMMMMMMMMMMMMMMNmhso++////+oshmNMMMMMMMMMMMMMMMNmhyo++////+osydNNNNMNNNM*/
/*M+NMMd///+osyyyyss+///+smNMMMMMMMMMNds+///osyyyyyso////sdNMMMMMMMMMNmy+///+osyyyyso+///ohNNNNNM*/
/*M+NNMdohmNNMNNNNNNNNdy+//odNMMMMNNh+//+ymNNNNNNNNNNNmy+//+hNNNNNNNdo//+sdNNNNNNNNNNNmho//+yNNNM*/
/*M+NNNNNNNmhysooosydNNNNh+//yNNNNms//+dNNNNdysooosydNNNNdo//omNNNNy//+hNNNNdysooooyhmNNNms//+dNM*/
/*M+NNNNNdo//////////+ymNNmo//smmdo//sNNNms///////////sdmmdo//+dmms//omNNNy+//////////odmmms//+dM*/
/*M+mNNNy//////////////+mNNm+///////oNNNd+//////////////////////////+mNNm+/////////////////////oM*/
/*M+mNNd////////////////sNNNmdddhhhhmNNm+////////////////hhhhhhhhhhhdNNNmhhhhhhhhhhhhhhhhhhhh///M*/
/*M+mNNd////////////////oNNNNNNNNNNNNNNm+////////////////dNNNNNNNNNNNNNNNNNNNNNNNNNNNNNNNNNNm+//M*/
/*M/hNNmo///////////////hNNNs///////yNNNy///////////////////////////////////////////////omNNh//+M*/
/*M/+dNNms////////////+hNNNy//+sss///hNNmy/////////////ssss+///sss+///ssss+////////////smNNd+//yM*/
/*M//+hmNNmyo+/////+shmNNms//+dNNNh+//ymNNmho+/////+ohmNNmy///hNNNd+//odNNmhs+//////oymNNmh+//ymM*/
/*Mh+//+ymNNNmmmdmmNNNmds///smNNNNNdo//+ydmNNNmmdmmmNNmdy+//odNNNNNms///sdmNNNmmdmmmNNNmy+//+hmNM*/
/*Mmmho///+syhdddddhyo+///sdmNNNNNNNmho///+syhdddddhys+///ohmNNNNNNNNds+//+oyhdddddhys+///ohmNNNM*/
/*Mmmmmdyo+///////////oshmmmNmmmmmmNNmmmhs+///////////+shmmNNNNNNNNNNNNmhso///////////+oydmNNmmmM*/
/*MmmmmmmmmmdhyyyyhddmmmmmmmmmmmmmmmmmmmmmmmddhyyyhddmmmmmmmmmmmmmmmmmmmmmmmddhyyyyhdmmmmmmmmmmmM*/
/*MMMMMMMMMMMMNNNNNMMMMMMMMMMMMMMMMMMMMMMMMMMMNNNNNMMMMMMMMMMMMMMMMMMMMMMMMMMMNNNNNNMMMMMMMMMMMMM*

  filename:     GW.can
  
  description:  Brief: GW
                Generation date: 12/05/2020 14:30:13
                DBC File: TRW_FE-6 ECU DBC V1.9_Release_ESCL_20171114.dbc
                User Name: BenY
                
  ATTENTIONS:   This file code generated by Tool automatically, don't modify this 
                file manually.  
 ----------------------------------------------------------------------------- */
/* -----------------------------------------------------------------------------
  C O P Y R I G H T
 -------------------------------------------------------------------------------
  Copyright (c) 2019 by Yueting Ben. All rights reserved.
 -------------------------------------------------------------------------------
/**************************************************************************************************/
includes
{
  #include "..\CRC\Geely_CRC.cin"
}

variables
{
  message IPK_TotalOdometer IPK_TotalOdometer_Frame;
  message EMS_EngineRPM EMS_EngineRPM_Frame;
  message ESC_FrontWheelSpeedsKPH ESC_FrontWheelSpeedsKPH_Frame;
  message ESC_RearWheelSpeedsKPH ESC_RearWheelSpeedsKPH_Frame;
  msTimer IPK_TotalOdometer_Timer;
  msTimer EMS_EngineRPM_Timer;
  msTimer ESC_FrontWheelSpeedsKPH_Timer;
  msTimer ESC_RearWheelSpeedsKPH_Timer;
  byte IPK_TotalOdometer_EnableFlag;
  byte EMS_EngineRPM_EnableFlag;
  byte EMS_EngineRPM_MsgCounterEnable;
  byte EMS_EngineRPM_CheckSumEnable;
  byte ESC_FrontWheelSpeedsKPH_EnableFlag;
  byte ESC_FrontWheelSpeedsKPH_MsgCounterEnable;
  byte ESC_FrontWheelSpeedsKPH_CheckSumEnable;
  byte ESC_RearWheelSpeedsKPH_EnableFlag;
  byte ESC_RearWheelSpeedsKPH_MsgCounterEnable;
  byte ESC_RearWheelSpeedsKPH_CheckSumEnable;
}
on start
{
  setTimer(IPK_TotalOdometer_Timer, 0);
  setTimer(EMS_EngineRPM_Timer, 0);
  setTimer(ESC_FrontWheelSpeedsKPH_Timer, 0);
  setTimer(ESC_RearWheelSpeedsKPH_Timer, 0);
  IPK_TotalOdometer_EnableFlag = @sysvar::MESSAGEFRAME::IPK_TotalOdometerMessageEnable & @sysvar::NODE::GWEnableAll_Msg;
  EMS_EngineRPM_EnableFlag = @sysvar::MESSAGEFRAME::EMS_EngineRPMMessageEnable & @sysvar::NODE::GWEnableAll_Msg;
  EMS_EngineRPM_MsgCounterEnable = @sysvar::MESSAGEFRAME::EMS_EngineRPMMsgCounterEnable;
  EMS_EngineRPM_CheckSumEnable = @sysvar::MESSAGEFRAME::EMS_EngineRPMCheckSumEnable;
  ESC_FrontWheelSpeedsKPH_EnableFlag = @sysvar::MESSAGEFRAME::ESC_FrontWheelSpeedsKPHMessageEnable & @sysvar::NODE::GWEnableAll_Msg;
  ESC_FrontWheelSpeedsKPH_MsgCounterEnable = @sysvar::MESSAGEFRAME::ESC_FrontWheelSpeedsKPHMsgCounterEnable;
  ESC_FrontWheelSpeedsKPH_CheckSumEnable = @sysvar::MESSAGEFRAME::ESC_FrontWheelSpeedsKPHCheckSumEnable;
  ESC_RearWheelSpeedsKPH_EnableFlag = @sysvar::MESSAGEFRAME::ESC_RearWheelSpeedsKPHMessageEnable & @sysvar::NODE::GWEnableAll_Msg;
  ESC_RearWheelSpeedsKPH_MsgCounterEnable = @sysvar::MESSAGEFRAME::ESC_RearWheelSpeedsKPHMsgCounterEnable;
  ESC_RearWheelSpeedsKPH_CheckSumEnable = @sysvar::MESSAGEFRAME::ESC_RearWheelSpeedsKPHCheckSumEnable;
}

/**************************************************************************************************/
/*
  brief:        Send IPK_TotalOdometer in cycle
  
  author:       Generation tool
*/
/**************************************************************************************************/
 on Timer IPK_TotalOdometer_Timer
{
  if(1 == IPK_TotalOdometer_EnableFlag)
  {
    output(IPK_TotalOdometer_Frame);
  }
  IPK_TotalOdometer_Frame.IPK_IPKTotalOdometer = @sysvar::SIGNALINFO::IPK_IPKTotalOdometerValue;
  setTimer(IPK_TotalOdometer_Timer, 1000);
}

/**************************************************************************************************/
/*
  brief:        Send EMS_EngineRPM in cycle
  
  author:       Generation tool
*/
/**************************************************************************************************/
 on Timer EMS_EngineRPM_Timer
{
  byte EMS_EngineRPM_MsgCounter;
  byte EMS_EngineRPM_CheckSum;
  byte msgRaw[7];
  
  if(1 == EMS_EngineRPM_EnableFlag)
  {
    output(EMS_EngineRPM_Frame);
  }
  EMS_EngineRPM_Frame.EMS_EngineSpeedRPM = @sysvar::SIGNALINFO::EMS_EngineSpeedRPMValue;

  EMS_EngineRPM_Frame.EMS_EngineSpeedRPMInvalid = @sysvar::SIGNALINFO::EMS_EngineSpeedRPMInvalidValue;
  EMS_EngineRPM_Frame.EMS_EngStatus = @sysvar::SIGNALINFO::EMS_EngStatusValue;
  if(1 == EMS_EngineRPM_MsgCounterEnable)
  {
    @sysvar::SIGNALINFO::EMS_EngineRPM_AliveCounterValue = EMS_EngineRPM_MsgCounter;
    EMS_EngineRPM_Frame.EMS_EngineRPM_AliveCounter = @sysvar::SIGNALINFO::EMS_EngineRPM_AliveCounterValue;
    EMS_EngineRPM_MsgCounter = EMS_EngineRPM_MsgCounter + 1;
  }
  
  /* Calculate checksum */ 
  msgRaw[0] = EMS_EngineRPM_Frame.byte(0);
  msgRaw[1] = EMS_EngineRPM_Frame.byte(1);
  msgRaw[2] = EMS_EngineRPM_Frame.byte(2);
  msgRaw[3] = EMS_EngineRPM_Frame.byte(3);
  msgRaw[4] = EMS_EngineRPM_Frame.byte(5);
  msgRaw[5] = EMS_EngineRPM_Frame.byte(6);
  msgRaw[6] = EMS_EngineRPM_Frame.byte(7);
  
  EMS_EngineRPM_CheckSum = Crc_CalculateCRC8H2F(msgRaw, 7, 0xff, 1);

  if(1 == EMS_EngineRPM_CheckSumEnable)
  {
    @sysvar::SIGNALINFO::EMS_EngineRPM_CheckSumValue = EMS_EngineRPM_CheckSum;
    EMS_EngineRPM_Frame.EMS_EngineRPM_CheckSum = @sysvar::SIGNALINFO::EMS_EngineRPM_CheckSumValue;
  }
  setTimer(EMS_EngineRPM_Timer, 10);
}

/**************************************************************************************************/
/*
  brief:        Send ESC_FrontWheelSpeedsKPH in cycle
  
  author:       Generation tool
*/
/**************************************************************************************************/
 on Timer ESC_FrontWheelSpeedsKPH_Timer
{
  byte ESC_FrontWheelSpeedsKPH_MsgCounter;
  byte ESC_FrontWheelSpeedsKPH_CheckSum;
  byte msgRaw[7];
  
  if(1 == ESC_FrontWheelSpeedsKPH_EnableFlag)
  {
    output(ESC_FrontWheelSpeedsKPH_Frame);
  }
  ESC_FrontWheelSpeedsKPH_Frame.ESC_FLWheelSpeedKPH = @sysvar::SIGNALINFO::ESC_FLWheelSpeedKPHValue;
  ESC_FrontWheelSpeedsKPH_Frame.ESC_FLWheelSpeedInvalid = @sysvar::SIGNALINFO::ESC_FLWheelSpeedInvalidValue;
  ESC_FrontWheelSpeedsKPH_Frame.ESC_FRWheelSpeedKPH = @sysvar::SIGNALINFO::ESC_FRWheelSpeedKPHValue;
  ESC_FrontWheelSpeedsKPH_Frame.ESC_FRWheelSpeedInvalid = @sysvar::SIGNALINFO::ESC_FRWheelSpeedInvalidValue;
  if(1 == ESC_FrontWheelSpeedsKPH_MsgCounterEnable)
  {
    @sysvar::SIGNALINFO::ESC_FrontWheelSpeedsKPH_CounterValue = ESC_FrontWheelSpeedsKPH_MsgCounter;
    ESC_FrontWheelSpeedsKPH_Frame.ESC_FrontWheelSpeedsKPH_Counter = @sysvar::SIGNALINFO::ESC_FrontWheelSpeedsKPH_CounterValue;
    ESC_FrontWheelSpeedsKPH_MsgCounter = ESC_FrontWheelSpeedsKPH_MsgCounter + 1;
  }
  /* Calculate checksum */ 
  msgRaw[0] = ESC_FrontWheelSpeedsKPH_Frame.byte(0);
  msgRaw[1] = ESC_FrontWheelSpeedsKPH_Frame.byte(1);
  msgRaw[2] = ESC_FrontWheelSpeedsKPH_Frame.byte(2);
  msgRaw[3] = ESC_FrontWheelSpeedsKPH_Frame.byte(3);
  msgRaw[4] = ESC_FrontWheelSpeedsKPH_Frame.byte(4);
  msgRaw[5] = ESC_FrontWheelSpeedsKPH_Frame.byte(5);
  msgRaw[6] = ESC_FrontWheelSpeedsKPH_Frame.byte(6);
  
  ESC_FrontWheelSpeedsKPH_CheckSum = Crc_CalculateCRC8H2F(msgRaw, 7, 0xff, 1);

  if(1 == ESC_FrontWheelSpeedsKPH_CheckSumEnable)
  {
    @sysvar::SIGNALINFO::ESC_FrontWheelSpeedsKPH_CheckSumValue = ESC_FrontWheelSpeedsKPH_CheckSum;
    ESC_FrontWheelSpeedsKPH_Frame.ESC_FrontWheelSpeedsKPH_CheckSum = @sysvar::SIGNALINFO::ESC_FrontWheelSpeedsKPH_CheckSumValue;
  }
  setTimer(ESC_FrontWheelSpeedsKPH_Timer, 20);
}

/**************************************************************************************************/
/*
  brief:        Send ESC_RearWheelSpeedsKPH in cycle
  
  author:       Generation tool
*/
/**************************************************************************************************/
 on Timer ESC_RearWheelSpeedsKPH_Timer
{
  byte ESC_RearWheelSpeedsKPH_MsgCounter;
  byte ESC_RearWheelSpeedsKPH_CheckSum;
  byte msgRaw[7];
  
  if(1 == ESC_RearWheelSpeedsKPH_EnableFlag)
  {
    output(ESC_RearWheelSpeedsKPH_Frame);
  }
  ESC_RearWheelSpeedsKPH_Frame.ESC_RLWheelSpeedKPH = @sysvar::SIGNALINFO::ESC_RLWheelSpeedKPHValue;
  ESC_RearWheelSpeedsKPH_Frame.ESC_RLWheelSpeedInvalid = @sysvar::SIGNALINFO::ESC_RLWheelSpeedInvalidValue;
  ESC_RearWheelSpeedsKPH_Frame.ESC_RRWheelSpeedKPH = @sysvar::SIGNALINFO::ESC_RRWheelSpeedKPHValue;
  ESC_RearWheelSpeedsKPH_Frame.ESC_RRWheelSpeedInvalid = @sysvar::SIGNALINFO::ESC_RRWheelSpeedInvalidValue;
  if(1 == ESC_RearWheelSpeedsKPH_MsgCounterEnable)
  {
    @sysvar::SIGNALINFO::ESC_RearWheelSpeedsKPH_CounterValue = ESC_RearWheelSpeedsKPH_MsgCounter;
    ESC_RearWheelSpeedsKPH_Frame.ESC_RearWheelSpeedsKPH_Counter = @sysvar::SIGNALINFO::ESC_RearWheelSpeedsKPH_CounterValue;
    ESC_RearWheelSpeedsKPH_MsgCounter = ESC_RearWheelSpeedsKPH_MsgCounter + 1;
  }
  /* Calculate checksum */ 
  msgRaw[0] = ESC_RearWheelSpeedsKPH_Frame.byte(0);
  msgRaw[1] = ESC_RearWheelSpeedsKPH_Frame.byte(1);
  msgRaw[2] = ESC_RearWheelSpeedsKPH_Frame.byte(2);
  msgRaw[3] = ESC_RearWheelSpeedsKPH_Frame.byte(3);
  msgRaw[4] = ESC_RearWheelSpeedsKPH_Frame.byte(4);
  msgRaw[5] = ESC_RearWheelSpeedsKPH_Frame.byte(5);
  msgRaw[6] = ESC_RearWheelSpeedsKPH_Frame.byte(6);
  ESC_RearWheelSpeedsKPH_CheckSum = Crc_CalculateCRC8H2F(msgRaw, 7, 0xff, 1);

  if(1 == ESC_RearWheelSpeedsKPH_CheckSumEnable)
  {
    @sysvar::SIGNALINFO::ESC_RearWheelSpeedsKPH_CheckSumValue = ESC_RearWheelSpeedsKPH_CheckSum;
    ESC_RearWheelSpeedsKPH_Frame.ESC_RearWheelSpeedsKPH_CheckSum = @sysvar::SIGNALINFO::ESC_RearWheelSpeedsKPH_CheckSumValue;
  }
  setTimer(ESC_RearWheelSpeedsKPH_Timer, 20);
}

/**************************************************************************************************/
/*
  brief:        Check the CheckBox GW_EnableAll_Msg
  
  author:       Generation tool
*/
/**************************************************************************************************/
 on sysvar NODE::GWEnableAll_Msg
{
  if(1 == @sysvar::NODE::GWEnableAll_Msg)
  {
    @sysvar::NODE::GWEnableAll_Msg = 1;
    @sysvar::NODE::GWDisableAll_Msg = 0;
    @sysvar::MESSAGEFRAME::IPK_TotalOdometerMessageEnable = 1;
    IPK_TotalOdometer_EnableFlag = @sysvar::MESSAGEFRAME::IPK_TotalOdometerMessageEnable & @sysvar::NODE::GWEnableAll_Msg;
    @sysvar::MESSAGEFRAME::EMS_EngineRPMMessageEnable = 1;
    EMS_EngineRPM_EnableFlag = @sysvar::MESSAGEFRAME::EMS_EngineRPMMessageEnable & @sysvar::NODE::GWEnableAll_Msg;
    @sysvar::MESSAGEFRAME::ESC_FrontWheelSpeedsKPHMessageEnable = 1;
    ESC_FrontWheelSpeedsKPH_EnableFlag = @sysvar::MESSAGEFRAME::ESC_FrontWheelSpeedsKPHMessageEnable & @sysvar::NODE::GWEnableAll_Msg;
    @sysvar::MESSAGEFRAME::ESC_RearWheelSpeedsKPHMessageEnable = 1;
    ESC_RearWheelSpeedsKPH_EnableFlag = @sysvar::MESSAGEFRAME::ESC_RearWheelSpeedsKPHMessageEnable & @sysvar::NODE::GWEnableAll_Msg;
  }
  else
  {
    @sysvar::NODE::GWEnableAll_Msg = 0;
    @sysvar::NODE::GWDisableAll_Msg = 1;
    @sysvar::MESSAGEFRAME::IPK_TotalOdometerMessageEnable = 0;
    IPK_TotalOdometer_EnableFlag = @sysvar::MESSAGEFRAME::IPK_TotalOdometerMessageEnable & @sysvar::NODE::GWEnableAll_Msg;
    @sysvar::MESSAGEFRAME::EMS_EngineRPMMessageEnable = 0;
    EMS_EngineRPM_EnableFlag = @sysvar::MESSAGEFRAME::EMS_EngineRPMMessageEnable & @sysvar::NODE::GWEnableAll_Msg;
    @sysvar::MESSAGEFRAME::ESC_FrontWheelSpeedsKPHMessageEnable = 0;
    ESC_FrontWheelSpeedsKPH_EnableFlag = @sysvar::MESSAGEFRAME::ESC_FrontWheelSpeedsKPHMessageEnable & @sysvar::NODE::GWEnableAll_Msg;
    @sysvar::MESSAGEFRAME::ESC_RearWheelSpeedsKPHMessageEnable = 0;
    ESC_RearWheelSpeedsKPH_EnableFlag = @sysvar::MESSAGEFRAME::ESC_RearWheelSpeedsKPHMessageEnable & @sysvar::NODE::GWEnableAll_Msg;
  }
}

/**************************************************************************************************/
/*
  brief:        Check the CheckBox GW_DisableAll_Msg
  
  author:       Generation tool
*/
/**************************************************************************************************/
 on sysvar NODE::GWDisableAll_Msg
{
  if(1 == @sysvar::NODE::GWDisableAll_Msg)
  {
    @sysvar::NODE::GWEnableAll_Msg = 0;
    @sysvar::NODE::GWDisableAll_Msg = 1;
    @sysvar::MESSAGEFRAME::IPK_TotalOdometerMessageEnable = 0;
    IPK_TotalOdometer_EnableFlag = @sysvar::MESSAGEFRAME::IPK_TotalOdometerMessageEnable & @sysvar::NODE::GWEnableAll_Msg;
    @sysvar::MESSAGEFRAME::EMS_EngineRPMMessageEnable = 0;
    EMS_EngineRPM_EnableFlag = @sysvar::MESSAGEFRAME::EMS_EngineRPMMessageEnable & @sysvar::NODE::GWEnableAll_Msg;
    @sysvar::MESSAGEFRAME::ESC_FrontWheelSpeedsKPHMessageEnable = 0;
    ESC_FrontWheelSpeedsKPH_EnableFlag = @sysvar::MESSAGEFRAME::ESC_FrontWheelSpeedsKPHMessageEnable & @sysvar::NODE::GWEnableAll_Msg;
    @sysvar::MESSAGEFRAME::ESC_RearWheelSpeedsKPHMessageEnable = 0;
    ESC_RearWheelSpeedsKPH_EnableFlag = @sysvar::MESSAGEFRAME::ESC_RearWheelSpeedsKPHMessageEnable & @sysvar::NODE::GWEnableAll_Msg;
  }
  else
  {
    @sysvar::NODE::GWEnableAll_Msg = 1;
    @sysvar::NODE::GWDisableAll_Msg = 0;
    @sysvar::MESSAGEFRAME::IPK_TotalOdometerMessageEnable = 1;
    IPK_TotalOdometer_EnableFlag = @sysvar::MESSAGEFRAME::IPK_TotalOdometerMessageEnable & @sysvar::NODE::GWEnableAll_Msg;
    @sysvar::MESSAGEFRAME::EMS_EngineRPMMessageEnable = 1;
    EMS_EngineRPM_EnableFlag = @sysvar::MESSAGEFRAME::EMS_EngineRPMMessageEnable & @sysvar::NODE::GWEnableAll_Msg;
    @sysvar::MESSAGEFRAME::ESC_FrontWheelSpeedsKPHMessageEnable = 1;
    ESC_FrontWheelSpeedsKPH_EnableFlag = @sysvar::MESSAGEFRAME::ESC_FrontWheelSpeedsKPHMessageEnable & @sysvar::NODE::GWEnableAll_Msg;
    @sysvar::MESSAGEFRAME::ESC_RearWheelSpeedsKPHMessageEnable = 1;
    ESC_RearWheelSpeedsKPH_EnableFlag = @sysvar::MESSAGEFRAME::ESC_RearWheelSpeedsKPHMessageEnable & @sysvar::NODE::GWEnableAll_Msg;
  }
}

/**************************************************************************************************/
/*
  brief:        Check the CheckBox IPK_TotalOdometer MessageEnable
  
  author:       Generation tool
*/
/**************************************************************************************************/
 on sysvar MESSAGEFRAME::IPK_TotalOdometerMessageEnable
{
  IPK_TotalOdometer_EnableFlag = @sysvar::MESSAGEFRAME::IPK_TotalOdometerMessageEnable & @sysvar::NODE::GWEnableAll_Msg;
}

/**************************************************************************************************/
/*
  brief:        Check the CheckBox EMS_EngineRPM MessageEnable
  
  author:       Generation tool
*/
/**************************************************************************************************/
 on sysvar MESSAGEFRAME::EMS_EngineRPMMessageEnable
{
  EMS_EngineRPM_EnableFlag = @sysvar::MESSAGEFRAME::EMS_EngineRPMMessageEnable & @sysvar::NODE::GWEnableAll_Msg;
}

/**************************************************************************************************/
/*
  brief:        Check the CheckBox EMS_EngineRPM MsgCounterEnable
  
  author:       Generation tool
*/
/**************************************************************************************************/
 on sysvar MESSAGEFRAME::EMS_EngineRPMMsgCounterEnable
{
  EMS_EngineRPM_MsgCounterEnable = @sysvar::MESSAGEFRAME::EMS_EngineRPMMsgCounterEnable;
}

/**************************************************************************************************/
/*
  brief:        Check the CheckBox EMS_EngineRPM CheckSumEnable
  
  author:       Generation tool
*/
/**************************************************************************************************/
 on sysvar MESSAGEFRAME::EMS_EngineRPMCheckSumEnable
{
  EMS_EngineRPM_CheckSumEnable = @sysvar::MESSAGEFRAME::EMS_EngineRPMCheckSumEnable;
}

/**************************************************************************************************/
/*
  brief:        Check the CheckBox ESC_FrontWheelSpeedsKPH MessageEnable
  
  author:       Generation tool
*/
/**************************************************************************************************/
 on sysvar MESSAGEFRAME::ESC_FrontWheelSpeedsKPHMessageEnable
{
  ESC_FrontWheelSpeedsKPH_EnableFlag = @sysvar::MESSAGEFRAME::ESC_FrontWheelSpeedsKPHMessageEnable & @sysvar::NODE::GWEnableAll_Msg;
}

/**************************************************************************************************/
/*
  brief:        Check the CheckBox ESC_FrontWheelSpeedsKPH MsgCounterEnable
  
  author:       Generation tool
*/
/**************************************************************************************************/
 on sysvar MESSAGEFRAME::ESC_FrontWheelSpeedsKPHMsgCounterEnable
{
  ESC_FrontWheelSpeedsKPH_MsgCounterEnable = @sysvar::MESSAGEFRAME::ESC_FrontWheelSpeedsKPHMsgCounterEnable;
}

/**************************************************************************************************/
/*
  brief:        Check the CheckBox ESC_FrontWheelSpeedsKPH CheckSumEnable
  
  author:       Generation tool
*/
/**************************************************************************************************/
 on sysvar MESSAGEFRAME::ESC_FrontWheelSpeedsKPHCheckSumEnable
{
  ESC_FrontWheelSpeedsKPH_CheckSumEnable = @sysvar::MESSAGEFRAME::ESC_FrontWheelSpeedsKPHCheckSumEnable;
}

/**************************************************************************************************/
/*
  brief:        Check the CheckBox ESC_RearWheelSpeedsKPH MessageEnable
  
  author:       Generation tool
*/
/**************************************************************************************************/
 on sysvar MESSAGEFRAME::ESC_RearWheelSpeedsKPHMessageEnable
{
  ESC_RearWheelSpeedsKPH_EnableFlag = @sysvar::MESSAGEFRAME::ESC_RearWheelSpeedsKPHMessageEnable & @sysvar::NODE::GWEnableAll_Msg;
}

/**************************************************************************************************/
/*
  brief:        Check the CheckBox ESC_RearWheelSpeedsKPH MsgCounterEnable
  
  author:       Generation tool
*/
/**************************************************************************************************/
 on sysvar MESSAGEFRAME::ESC_RearWheelSpeedsKPHMsgCounterEnable
{
  ESC_RearWheelSpeedsKPH_MsgCounterEnable = @sysvar::MESSAGEFRAME::ESC_RearWheelSpeedsKPHMsgCounterEnable;
}

/**************************************************************************************************/
/*
  brief:        Check the CheckBox ESC_RearWheelSpeedsKPH CheckSumEnable
  
  author:       Generation tool
*/
/**************************************************************************************************/
 on sysvar MESSAGEFRAME::ESC_RearWheelSpeedsKPHCheckSumEnable
{
  ESC_RearWheelSpeedsKPH_CheckSumEnable = @sysvar::MESSAGEFRAME::ESC_RearWheelSpeedsKPHCheckSumEnable;
}

on busOff
{
  resetCan();
}
