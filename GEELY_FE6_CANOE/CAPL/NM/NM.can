/*MMMMMMMMMMMMNNNNNMMMMMMMMMMMMMMMMMMMMMMMMMMMNNNNNMMMMMMMMMMMMMMMMMMMMMMMMMMMNNNNNNMMMMMMMMMMMMM*/
/*M+NMMMNdyso+////++oyhmNMMMMMMMMMMMMMMMNmhso++////+oshmNMMMMMMMMMMMMMMMNmhyo++////+osydNNNNMNNNM*/
/*M+NMMd///+osyyyyss+///+smNMMMMMMMMMNds+///osyyyyyso////sdNMMMMMMMMMNmy+///+osyyyyso+///ohNNNNNM*/
/*M+NNMdohmNNMNNNNNNNNdy+//odNMMMMNNh+//+ymNNNNNNNNNNNmy+//+hNNNNNNNdo//+sdNNNNNNNNNNNmho//+yNNNM*/
/*M+NNNNNNNmhysooosydNNNNh+//yNNNNms//+dNNNNdysooosydNNNNdo//omNNNNy//+hNNNNdysooooyhmNNNms//+dNM*/
/*M+NNNNNdo//////////+ymNNmo//smmdo//sNNNms///////////sdmmdo//+dmms//omNNNy+//////////odmmms//+dM*/
/*M+mNNNy//////////////+mNNm+///////oNNNd+//////////////////////////+mNNm+/////////////////////oM*/
/*M+mNNd////////////////sNNNmdddhhhhmNNm+////////////////hhhhhhhhhhhdNNNmhhhhhhhhhhhhhhhhhhhh///M*/
/*M+mNNd////////////////oNNNNNNNNNNNNNNm+////////////////dNNNNNNNNNNNNNNNNNNNNNNNNNNNNNNNNNNm+//M*/
/*M/hNNmo///////////////hNNNs///////yNNNy///////////////////////////////////////////////omNNh//+M*/
/*M/+dNNms////////////+hNNNy//+sss///hNNmy/////////////ssss+///sss+///ssss+////////////smNNd+//yM*/
/*M//+hmNNmyo+/////+shmNNms//+dNNNh+//ymNNmho+/////+ohmNNmy///hNNNd+//odNNmhs+//////oymNNmh+//ymM*/
/*Mh+//+ymNNNmmmdmmNNNmds///smNNNNNdo//+ydmNNNmmdmmmNNmdy+//odNNNNNms///sdmNNNmmdmmmNNNmy+//+hmNM*/
/*Mmmho///+syhdddddhyo+///sdmNNNNNNNmho///+syhdddddhys+///ohmNNNNNNNNds+//+oyhdddddhys+///ohmNNNM*/
/*Mmmmmdyo+///////////oshmmmNmmmmmmNNmmmhs+///////////+shmmNNNNNNNNNNNNmhso///////////+oydmNNmmmM*/
/*MmmmmmmmmmdhyyyyhddmmmmmmmmmmmmmmmmmmmmmmmddhyyyhddmmmmmmmmmmmmmmmmmmmmmmmddhyyyyhdmmmmmmmmmmmM*/
/*MMMMMMMMMMMMNNNNNMMMMMMMMMMMMMMMMMMMMMMMMMMMNNNNNMMMMMMMMMMMMMMMMMMMMMMMMMMMNNNNNNMMMMMMMMMMMMM*

  filename:     NM.can
  
  description:  Brief: NM
                Generation date: 12/05/2020 14:30:13
                DBC File: TRW_FE-6 ECU DBC V1.9_Release_ESCL_20171114.dbc
                User Name: BenY
                
  ATTENTIONS:   This file code generated by Tool automatically, don't modify this 
                file manually.  
 ----------------------------------------------------------------------------- */
/* -----------------------------------------------------------------------------
  C O P Y R I G H T
 -------------------------------------------------------------------------------
  Copyright (c) 2019 by Yueting Ben. All rights reserved.
 -------------------------------------------------------------------------------
/**************************************************************************************************/
 variables
{
  message 0x401 NMMessage_Frame = {dlc = 8};
  msTimer NMMessage_Timer;
  byte NMMessage_EnableFlag;
}
on start
{
  setTimer(NMMessage_Timer, 0);
  NMMessage_EnableFlag = @sysvar::MESSAGEFRAME::NM_NMMessageEnable & @sysvar::NODE::NMEnableAll_Msg;
}

/**************************************************************************************************/
/*
  brief:        Send BCM_LDoorWindowState in cycle
  
  author:       Generation tool
*/
/**************************************************************************************************/
 on Timer NMMessage_Timer
{
  if(1 == NMMessage_EnableFlag)
  {
    output(NMMessage_Frame);
  }
  setTimer(NMMessage_Timer, 500);
}

/**************************************************************************************************/
/*
  brief:        Check the CheckBox BCM_EnableAll_Msg
  
  author:       Generation tool
*/
/**************************************************************************************************/
 on sysvar NODE::NMEnableAll_Msg
{
  if(1 == @sysvar::NODE::NMEnableAll_Msg)
  {
    @sysvar::NODE::NMEnableAll_Msg = 1;
    @sysvar::NODE::NMDisableAll_Msg = 0;
    @sysvar::MESSAGEFRAME::NM_NMMessageEnable = 1;
    NMMessage_EnableFlag = @sysvar::MESSAGEFRAME::NM_NMMessageEnable & @sysvar::NODE::NMEnableAll_Msg;
  }
  else
  {
    @sysvar::NODE::NMEnableAll_Msg = 0;
    @sysvar::NODE::NMDisableAll_Msg = 1;
    @sysvar::MESSAGEFRAME::NM_NMMessageEnable = 0;
    NMMessage_EnableFlag = @sysvar::MESSAGEFRAME::NM_NMMessageEnable & @sysvar::NODE::NMEnableAll_Msg;
  }
}

/**************************************************************************************************/
/*
  brief:        Check the CheckBox BCM_DisableAll_Msg
  
  author:       Generation tool
*/
/**************************************************************************************************/
 on sysvar NODE::NMDisableAll_Msg
{
  if(1 == @sysvar::NODE::NMDisableAll_Msg)
  {
    @sysvar::NODE::NMEnableAll_Msg = 0;
    @sysvar::NODE::NMDisableAll_Msg = 1;
    @sysvar::MESSAGEFRAME::NM_NMMessageEnable = 0;
    NMMessage_EnableFlag = @sysvar::MESSAGEFRAME::NM_NMMessageEnable & @sysvar::NODE::NMEnableAll_Msg;
  }
  else
  {
    @sysvar::NODE::NMEnableAll_Msg = 1;
    @sysvar::NODE::NMDisableAll_Msg = 0;
    @sysvar::MESSAGEFRAME::NM_NMMessageEnable = 1;
    NMMessage_EnableFlag = @sysvar::MESSAGEFRAME::NM_NMMessageEnable & @sysvar::NODE::NMEnableAll_Msg;
  }
}

/**************************************************************************************************/
/*
  brief:        Check the CheckBox BCM_LDoorWindowState MessageEnable
  
  author:       Generation tool
*/
/**************************************************************************************************/
 on sysvar MESSAGEFRAME::NM_NMMessageEnable
{
  NMMessage_EnableFlag = @sysvar::MESSAGEFRAME::NM_NMMessageEnable & @sysvar::NODE::NMEnableAll_Msg;
}

