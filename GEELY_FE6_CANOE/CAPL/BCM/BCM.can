/*MMMMMMMMMMMMNNNNNMMMMMMMMMMMMMMMMMMMMMMMMMMMNNNNNMMMMMMMMMMMMMMMMMMMMMMMMMMMNNNNNNMMMMMMMMMMMMM*/
/*M+NMMMNdyso+////++oyhmNMMMMMMMMMMMMMMMNmhso++////+oshmNMMMMMMMMMMMMMMMNmhyo++////+osydNNNNMNNNM*/
/*M+NMMd///+osyyyyss+///+smNMMMMMMMMMNds+///osyyyyyso////sdNMMMMMMMMMNmy+///+osyyyyso+///ohNNNNNM*/
/*M+NNMdohmNNMNNNNNNNNdy+//odNMMMMNNh+//+ymNNNNNNNNNNNmy+//+hNNNNNNNdo//+sdNNNNNNNNNNNmho//+yNNNM*/
/*M+NNNNNNNmhysooosydNNNNh+//yNNNNms//+dNNNNdysooosydNNNNdo//omNNNNy//+hNNNNdysooooyhmNNNms//+dNM*/
/*M+NNNNNdo//////////+ymNNmo//smmdo//sNNNms///////////sdmmdo//+dmms//omNNNy+//////////odmmms//+dM*/
/*M+mNNNy//////////////+mNNm+///////oNNNd+//////////////////////////+mNNm+/////////////////////oM*/
/*M+mNNd////////////////sNNNmdddhhhhmNNm+////////////////hhhhhhhhhhhdNNNmhhhhhhhhhhhhhhhhhhhh///M*/
/*M+mNNd////////////////oNNNNNNNNNNNNNNm+////////////////dNNNNNNNNNNNNNNNNNNNNNNNNNNNNNNNNNNm+//M*/
/*M/hNNmo///////////////hNNNs///////yNNNy///////////////////////////////////////////////omNNh//+M*/
/*M/+dNNms////////////+hNNNy//+sss///hNNmy/////////////ssss+///sss+///ssss+////////////smNNd+//yM*/
/*M//+hmNNmyo+/////+shmNNms//+dNNNh+//ymNNmho+/////+ohmNNmy///hNNNd+//odNNmhs+//////oymNNmh+//ymM*/
/*Mh+//+ymNNNmmmdmmNNNmds///smNNNNNdo//+ydmNNNmmdmmmNNmdy+//odNNNNNms///sdmNNNmmdmmmNNNmy+//+hmNM*/
/*Mmmho///+syhdddddhyo+///sdmNNNNNNNmho///+syhdddddhys+///ohmNNNNNNNNds+//+oyhdddddhys+///ohmNNNM*/
/*Mmmmmdyo+///////////oshmmmNmmmmmmNNmmmhs+///////////+shmmNNNNNNNNNNNNmhso///////////+oydmNNmmmM*/
/*MmmmmmmmmmdhyyyyhddmmmmmmmmmmmmmmmmmmmmmmmddhyyyhddmmmmmmmmmmmmmmmmmmmmmmmddhyyyyhdmmmmmmmmmmmM*/
/*MMMMMMMMMMMMNNNNNMMMMMMMMMMMMMMMMMMMMMMMMMMMNNNNNMMMMMMMMMMMMMMMMMMMMMMMMMMMNNNNNNMMMMMMMMMMMMM*

  filename:     BCM.can
  
  description:  Brief: BCM
                Generation date: 12/05/2020 14:30:13
                DBC File: TRW_FE-6 ECU DBC V1.9_Release_ESCL_20171114.dbc
                User Name: BenY
                
  ATTENTIONS:   This file code generated by Tool automatically, don't modify this 
                file manually.  
 ----------------------------------------------------------------------------- */
/* -----------------------------------------------------------------------------
  C O P Y R I G H T
 -------------------------------------------------------------------------------
  Copyright (c) 2019 by Yueting Ben. All rights reserved.
 -------------------------------------------------------------------------------
/**************************************************************************************************/
 variables
{
  message BCM_LDoorWindowState BCM_LDoorWindowState_Frame;
  msTimer BCM_LDoorWindowState_Timer;
  byte BCM_LDoorWindowState_EnableFlag;
}
on start
{
  setTimer(BCM_LDoorWindowState_Timer, 0);
  BCM_LDoorWindowState_EnableFlag = @sysvar::MESSAGEFRAME::BCM_LDoorWindowStateMessageEnable & @sysvar::NODE::BCMEnableAll_Msg;
}

/**************************************************************************************************/
/*
  brief:        Send BCM_LDoorWindowState in cycle
  
  author:       Generation tool
*/
/**************************************************************************************************/
 on Timer BCM_LDoorWindowState_Timer
{
  if(1 == BCM_LDoorWindowState_EnableFlag)
  {
    output(BCM_LDoorWindowState_Frame);
  }
  BCM_LDoorWindowState_Frame.BCM_FrontLeftDoorAjarStatus = @sysvar::SIGNALINFO::BCM_FrontLeftDoorAjarStatusValue;
  setTimer(BCM_LDoorWindowState_Timer, 100);
}

/**************************************************************************************************/
/*
  brief:        Check the CheckBox BCM_EnableAll_Msg
  
  author:       Generation tool
*/
/**************************************************************************************************/
 on sysvar NODE::BCMEnableAll_Msg
{
  if(1 == @sysvar::NODE::BCMEnableAll_Msg)
  {
    @sysvar::NODE::BCMEnableAll_Msg = 1;
    @sysvar::NODE::BCMDisableAll_Msg = 0;
    @sysvar::MESSAGEFRAME::BCM_LDoorWindowStateMessageEnable = 1;
    BCM_LDoorWindowState_EnableFlag = @sysvar::MESSAGEFRAME::BCM_LDoorWindowStateMessageEnable & @sysvar::NODE::BCMEnableAll_Msg;
  }
  else
  {
    @sysvar::NODE::BCMEnableAll_Msg = 0;
    @sysvar::NODE::BCMDisableAll_Msg = 1;
    @sysvar::MESSAGEFRAME::BCM_LDoorWindowStateMessageEnable = 0;
    BCM_LDoorWindowState_EnableFlag = @sysvar::MESSAGEFRAME::BCM_LDoorWindowStateMessageEnable & @sysvar::NODE::BCMEnableAll_Msg;
  }
}

/**************************************************************************************************/
/*
  brief:        Check the CheckBox BCM_DisableAll_Msg
  
  author:       Generation tool
*/
/**************************************************************************************************/
 on sysvar NODE::BCMDisableAll_Msg
{
  if(1 == @sysvar::NODE::BCMDisableAll_Msg)
  {
    @sysvar::NODE::BCMEnableAll_Msg = 0;
    @sysvar::NODE::BCMDisableAll_Msg = 1;
    @sysvar::MESSAGEFRAME::BCM_LDoorWindowStateMessageEnable = 0;
    BCM_LDoorWindowState_EnableFlag = @sysvar::MESSAGEFRAME::BCM_LDoorWindowStateMessageEnable & @sysvar::NODE::BCMEnableAll_Msg;
  }
  else
  {
    @sysvar::NODE::BCMEnableAll_Msg = 1;
    @sysvar::NODE::BCMDisableAll_Msg = 0;
    @sysvar::MESSAGEFRAME::BCM_LDoorWindowStateMessageEnable = 1;
    BCM_LDoorWindowState_EnableFlag = @sysvar::MESSAGEFRAME::BCM_LDoorWindowStateMessageEnable & @sysvar::NODE::BCMEnableAll_Msg;
  }
}

/**************************************************************************************************/
/*
  brief:        Check the CheckBox BCM_LDoorWindowState MessageEnable
  
  author:       Generation tool
*/
/**************************************************************************************************/
 on sysvar MESSAGEFRAME::BCM_LDoorWindowStateMessageEnable
{
  BCM_LDoorWindowState_EnableFlag = @sysvar::MESSAGEFRAME::BCM_LDoorWindowStateMessageEnable & @sysvar::NODE::BCMEnableAll_Msg;
}

