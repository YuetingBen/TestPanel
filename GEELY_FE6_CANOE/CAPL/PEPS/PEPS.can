/*@!Encoding:936*/
/*MMMMMMMMMMMMNNNNNMMMMMMMMMMMMMMMMMMMMMMMMMMMNNNNNMMMMMMMMMMMMMMMMMMMMMMMMMMMNNNNNNMMMMMMMMMMMMM*/
/*M+NMMMNdyso+////++oyhmNMMMMMMMMMMMMMMMNmhso++////+oshmNMMMMMMMMMMMMMMMNmhyo++////+osydNNNNMNNNM*/
/*M+NMMd///+osyyyyss+///+smNMMMMMMMMMNds+///osyyyyyso////sdNMMMMMMMMMNmy+///+osyyyyso+///ohNNNNNM*/
/*M+NNMdohmNNMNNNNNNNNdy+//odNMMMMNNh+//+ymNNNNNNNNNNNmy+//+hNNNNNNNdo//+sdNNNNNNNNNNNmho//+yNNNM*/
/*M+NNNNNNNmhysooosydNNNNh+//yNNNNms//+dNNNNdysooosydNNNNdo//omNNNNy//+hNNNNdysooooyhmNNNms//+dNM*/
/*M+NNNNNdo//////////+ymNNmo//smmdo//sNNNms///////////sdmmdo//+dmms//omNNNy+//////////odmmms//+dM*/
/*M+mNNNy//////////////+mNNm+///////oNNNd+//////////////////////////+mNNm+/////////////////////oM*/
/*M+mNNd////////////////sNNNmdddhhhhmNNm+////////////////hhhhhhhhhhhdNNNmhhhhhhhhhhhhhhhhhhhh///M*/
/*M+mNNd////////////////oNNNNNNNNNNNNNNm+////////////////dNNNNNNNNNNNNNNNNNNNNNNNNNNNNNNNNNNm+//M*/
/*M/hNNmo///////////////hNNNs///////yNNNy///////////////////////////////////////////////omNNh//+M*/
/*M/+dNNms////////////+hNNNy//+sss///hNNmy/////////////ssss+///sss+///ssss+////////////smNNd+//yM*/
/*M//+hmNNmyo+/////+shmNNms//+dNNNh+//ymNNmho+/////+ohmNNmy///hNNNd+//odNNmhs+//////oymNNmh+//ymM*/
/*Mh+//+ymNNNmmmdmmNNNmds///smNNNNNdo//+ydmNNNmmdmmmNNmdy+//odNNNNNms///sdmNNNmmdmmmNNNmy+//+hmNM*/
/*Mmmho///+syhdddddhyo+///sdmNNNNNNNmho///+syhdddddhys+///ohmNNNNNNNNds+//+oyhdddddhys+///ohmNNNM*/
/*Mmmmmdyo+///////////oshmmmNmmmmmmNNmmmhs+///////////+shmmNNNNNNNNNNNNmhso///////////+oydmNNmmmM*/
/*MmmmmmmmmmdhyyyyhddmmmmmmmmmmmmmmmmmmmmmmmddhyyyhddmmmmmmmmmmmmmmmmmmmmmmmddhyyyyhdmmmmmmmmmmmM*/
/*MMMMMMMMMMMMNNNNNMMMMMMMMMMMMMMMMMMMMMMMMMMMNNNNNMMMMMMMMMMMMMMMMMMMMMMMMMMMNNNNNNMMMMMMMMMMMMM*

  filename:     PEPS.can
  
  description:  Brief: PEPS
                Generation date: 12/05/2020 14:30:13
                DBC File: TRW_FE-6 ECU DBC V1.9_Release_ESCL_20171114.dbc
                User Name: BenY
                
  ATTENTIONS:   This file code generated by Tool automatically, don't modify this 
                file manually.  
 ----------------------------------------------------------------------------- */
/* -----------------------------------------------------------------------------
  C O P Y R I G H T
 -------------------------------------------------------------------------------
  Copyright (c) 2019 by Yueting Ben. All rights reserved.
 -------------------------------------------------------------------------------
/**************************************************************************************************/
includes
{
  #include "..\CRC\Geely_CRC.cin"
}

variables
{
  message PEPS_Message_Sts PEPS_Message_Sts_Frame;
  msTimer PEPS_Message_Sts_Timer;
  byte PEPS_Message_Sts_EnableFlag;
  byte PEPS_Message_Sts_MsgCounterEnable;
  byte PEPS_Message_Sts_CheckSumEnable;
  
  msTimer PEPS_Test_Timer;
  message PEPS_KeyReminder PEPS_KeyReminder_Frame;
  byte autoFlag;
}
on start
{
  setTimer(PEPS_Message_Sts_Timer, 0);
  PEPS_Message_Sts_EnableFlag = @sysvar::MESSAGEFRAME::PEPS_Message_StsMessageEnable & @sysvar::NODE::PEPSEnableAll_Msg;
  PEPS_Message_Sts_MsgCounterEnable = @sysvar::MESSAGEFRAME::PEPS_Message_StsMsgCounterEnable;
  PEPS_Message_Sts_CheckSumEnable = @sysvar::MESSAGEFRAME::PEPS_Message_StsCheckSumEnable;
}

/**************************************************************************************************/
/*
  brief:        Send PEPS_Message_Sts in cycle
  
  author:       Generation tool
*/
/**************************************************************************************************/
 on Timer PEPS_Message_Sts_Timer
{
  byte PEPS_Message_Sts_MsgCounter;
  byte PEPS_Message_Sts_CheckSum;
  byte msgRaw[7];
  
  if(1 == PEPS_Message_Sts_EnableFlag)
  {
    output(PEPS_Message_Sts_Frame);
  }
  @sysvar::SIGNALINFO::PEPS_PowerModeValidityValue = 2;
  PEPS_Message_Sts_Frame.PEPS_PowerModeValidity = @sysvar::SIGNALINFO::PEPS_PowerModeValidityValue;
  PEPS_Message_Sts_Frame.PEPS_PowerMode = @sysvar::SIGNALINFO::PEPS_PowerModeValue;
  if(1 == PEPS_Message_Sts_MsgCounterEnable)
  {
    @sysvar::SIGNALINFO::PEPS_Message_Sts_AliveCounterValue = PEPS_Message_Sts_MsgCounter;
    PEPS_Message_Sts_Frame.PEPS_Message_Sts_AliveCounter = @sysvar::SIGNALINFO::PEPS_Message_Sts_AliveCounterValue;
    PEPS_Message_Sts_MsgCounter = PEPS_Message_Sts_MsgCounter + 1;
  }
  /* Calculate checksum */ 
  msgRaw[0] = PEPS_Message_Sts_Frame.byte(0);
  msgRaw[1] = PEPS_Message_Sts_Frame.byte(1);
  msgRaw[2] = PEPS_Message_Sts_Frame.byte(2);
  msgRaw[3] = PEPS_Message_Sts_Frame.byte(3);
  msgRaw[4] = PEPS_Message_Sts_Frame.byte(4);
  msgRaw[5] = PEPS_Message_Sts_Frame.byte(5);
  msgRaw[6] = PEPS_Message_Sts_Frame.byte(6);
  
  PEPS_Message_Sts_CheckSum = Crc_CalculateCRC8H2F(msgRaw, 7, 0xff, 1);
  
  if(1 == PEPS_Message_Sts_CheckSumEnable)
  {
    @sysvar::SIGNALINFO::PEPS_Message_Sts_CheckSumValue = PEPS_Message_Sts_CheckSum;
    PEPS_Message_Sts_Frame.PEPS_Message_Sts_CheckSum = @sysvar::SIGNALINFO::PEPS_Message_Sts_CheckSumValue;
  }
  setTimer(PEPS_Message_Sts_Timer, 20);
}

/**************************************************************************************************/
/*
  brief:        Check the CheckBox PEPS_EnableAll_Msg
  
  author:       Generation tool
*/
/**************************************************************************************************/
 on sysvar NODE::PEPSEnableAll_Msg
{
  if(1 == @sysvar::NODE::PEPSEnableAll_Msg)
  {
    @sysvar::NODE::PEPSEnableAll_Msg = 1;
    @sysvar::NODE::PEPSDisableAll_Msg = 0;
    @sysvar::MESSAGEFRAME::PEPS_Message_StsMessageEnable = 1;
    PEPS_Message_Sts_EnableFlag = @sysvar::MESSAGEFRAME::PEPS_Message_StsMessageEnable & @sysvar::NODE::PEPSEnableAll_Msg;
  }
  else
  {
    @sysvar::NODE::PEPSEnableAll_Msg = 0;
    @sysvar::NODE::PEPSDisableAll_Msg = 1;
    @sysvar::MESSAGEFRAME::PEPS_Message_StsMessageEnable = 0;
    PEPS_Message_Sts_EnableFlag = @sysvar::MESSAGEFRAME::PEPS_Message_StsMessageEnable & @sysvar::NODE::PEPSEnableAll_Msg;
  }
}

/**************************************************************************************************/
/*
  brief:        Check the CheckBox PEPS_DisableAll_Msg
  
  author:       Generation tool
*/
/**************************************************************************************************/
 on sysvar NODE::PEPSDisableAll_Msg
{
  if(1 == @sysvar::NODE::PEPSDisableAll_Msg)
  {
    @sysvar::NODE::PEPSEnableAll_Msg = 0;
    @sysvar::NODE::PEPSDisableAll_Msg = 1;
    @sysvar::MESSAGEFRAME::PEPS_Message_StsMessageEnable = 0;
    PEPS_Message_Sts_EnableFlag = @sysvar::MESSAGEFRAME::PEPS_Message_StsMessageEnable & @sysvar::NODE::PEPSEnableAll_Msg;
  }
  else
  {
    @sysvar::NODE::PEPSEnableAll_Msg = 1;
    @sysvar::NODE::PEPSDisableAll_Msg = 0;
    @sysvar::MESSAGEFRAME::PEPS_Message_StsMessageEnable = 1;
    PEPS_Message_Sts_EnableFlag = @sysvar::MESSAGEFRAME::PEPS_Message_StsMessageEnable & @sysvar::NODE::PEPSEnableAll_Msg;
  }
}

/**************************************************************************************************/
/*
  brief:        Check the CheckBox PEPS_Message_Sts MessageEnable
  
  author:       Generation tool
*/
/**************************************************************************************************/
 on sysvar MESSAGEFRAME::PEPS_Message_StsMessageEnable
{
  PEPS_Message_Sts_EnableFlag = @sysvar::MESSAGEFRAME::PEPS_Message_StsMessageEnable & @sysvar::NODE::PEPSEnableAll_Msg;
}

/**************************************************************************************************/
/*
  brief:        Check the CheckBox PEPS_Message_Sts MsgCounterEnable
  
  author:       Generation tool
*/
/**************************************************************************************************/
 on sysvar MESSAGEFRAME::PEPS_Message_StsMsgCounterEnable
{
  PEPS_Message_Sts_MsgCounterEnable = @sysvar::MESSAGEFRAME::PEPS_Message_StsMsgCounterEnable;
}

/**************************************************************************************************/
/*
  brief:        Check the CheckBox PEPS_Message_Sts CheckSumEnable
  
  author:       Generation tool
*/
/**************************************************************************************************/
 on sysvar MESSAGEFRAME::PEPS_Message_StsCheckSumEnable
{
  PEPS_Message_Sts_CheckSumEnable = @sysvar::MESSAGEFRAME::PEPS_Message_StsCheckSumEnable;
}

on key 'p'
{
  @sysvar::SIGNALINFO::PEPS_PowerModeValue = 2;
}
on key 'o'
{
  @sysvar::SIGNALINFO::PEPS_PowerModeValue = 0;
  setTimer(PEPS_Test_Timer, 2060);
}

on timer PEPS_Test_Timer
{
  if(1 == autoFlag)
  {
    PEPS_KeyReminder_Frame.PEPS_Auth_ESCL_Req = 0x01;
    PEPS_KeyReminder_Frame.PEPS_LOCK_CMD = 0x00;
    PEPS_KeyReminder_Frame.PEPS_RKECommand = 0x00;
    output(PEPS_KeyReminder_Frame);
  }
}
ON key 'q'
{
  if(1 == autoFlag)
  {
    autoFlag = 0;
  }
  else
  {
    autoFlag = 1;
  }
}